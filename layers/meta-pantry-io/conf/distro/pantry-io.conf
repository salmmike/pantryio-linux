## layers/meta-pantry-io/conf/distro/pantry-io.conf
```bitbake
require conf/distro/poky.conf

DISTRO = "pantry-io"
DISTRO_NAME = "Pantry-io linux distribution"
DISTRO_VERSION = "0.0.1"

DISTRO_FEATURES:append = " systemd pam fontconfig tslib wayland gtk4 "
PREFERRED_PROVIDER_virtual/wpebackend = "wpebackend-rdk"
DISTRO_FEATURES_BACKFILL_CONSIDERED = "sysvinit"
VIRTUAL-RUNTIME_init_manager = "systemd"
VIRTUAL-RUNTIME_initscripts = ""
```

## layers/meta-pantry-io/conf/layer.conf
```bitbake
# We have a conf and classes directory, add to BBPATH
BBPATH .= ":${LAYERDIR}"

# We have recipes-* directories, add to BBFILES
BBFILES += "${LAYERDIR}/recipes-*/*/*.bb \
            ${LAYERDIR}/recipes-*/*/*.bbappend"

BBFILE_COLLECTIONS += "meta-pantry-io"
BBFILE_PATTERN_meta-pantry-io = "^${LAYERDIR}/"
BBFILE_PRIORITY_meta-pantry-io = "10"

LAYERDEPENDS_meta-pantry-io = "core"
LAYERSERIES_COMPAT_meta-pantry-io = "kirkstone"
```

## layers/pantry-io/conf/distro/pantry-io.conf
```bitbake
DISTRO_NAME = "pantry-io linux distribution"
DISTRO_VERSION = "0.1"


# =========================================================================
# DISTRO features
# =========================================================================
DISTRO_FEATURES:append = " opengl"
DISTRO_FEATURES:remove = " x11 "
# with X11
#PREFERRED_PROVIDER_virtual/xserver = "${@bb.utils.contains('DISTRO_FEATURES', 'x11 wayland', 'xwayland', 'xserver-xorg', d)}"

DISTRO_FEATURES:append = " gplv3 "

# =========================================================================
# DISTRO features
# =========================================================================
#DISTRO_FEATURES  = "alsa"
DISTRO_FEATURES += "argp"
DISTRO_FEATURES += "ext2"
DISTRO_FEATURES += "ext4"
DISTRO_FEATURES += "largefile"
DISTRO_FEATURES += "ipv4"
DISTRO_FEATURES += "ipv6"
DISTRO_FEATURES += "multiarch"
DISTRO_FEATURES += "pci"
DISTRO_FEATURES += "wifi"
DISTRO_FEATURES += "nfs"
DISTRO_FEATURES += "usbgadget"
DISTRO_FEATURES += "usbhost"
DISTRO_FEATURES += "xattr"
DISTRO_FEATURES += "zeroconf"
DISTRO_FEATURES += "bluetooth"
DISTRO_FEATURES += "bluez5"

# add support of gstreamer
DISTRO_FEATURES:append = " gstreamer "

# add support of optee
DISTRO_FEATURES:append = " optee "

# add support of splashscreen
DISTRO_FEATURES:append = " splashscreen "

# add support of wayland
DISTRO_FEATURES:append = " wayland pam "

# add support of X11
DISTRO_FEATURES:append = " x11 "

# add support of KDE (since OE thud version)
DISTRO_FEATURES:append = " kde "

# add support of systemd
DISTRO_FEATURES:append = " systemd polkit "

# add support of efi
DISTRO_FEATURES:append = " efi "

# add support of InitRD installation package
DISTRO_FEATURES:append = " initrd "

# add support of autoresize through InitRD
DISTRO_FEATURES:append = " autoresize "

# add support of tpm2
#DISTRO_FEATURES:append = " tpm2 "

# Disabling pulseaudio
#DISTRO_FEATURES_BACKFILL_CONSIDERED += "pulseaudio"
DISTRO_FEATURES:append = "pulseaudio"

# Disabling sysvinit
DISTRO_FEATURES_BACKFILL_CONSIDERED += "sysvinit"

VIRTUAL-RUNTIME_init_manager = "systemd"
VIRTUAL-RUNTIME_initscripts = "systemd-compat-units"

# =========================================================================
# Preferred version
# =========================================================================

# v4l-utils
#PREFERRED_VERSION_v4l-utils ?= "1.6.2"

# =========================================================================
# IMAGE addons
# =========================================================================
IMAGE_LINGUAS = "en-us en-gb"

LICENSE_FLAGS_ACCEPTED += " non-commercial commercial"

# X11 addons
DISTRO_EXTRA_RDEPENDS:append = " ${@bb.utils.contains('DISTRO_FEATURES', 'x11', 'xf86-video-modesetting', '', d)} "

# INITRD addons to image
DISTRO_EXTRA_RRECOMMENDS:append = " ${@bb.utils.contains('COMBINED_FEATURES', 'initrd', '${INITRD_PACKAGE}', '', d)} "

PREFERRED_PROVIDER_libevent = "libevent-fb"
PREFERRED_PROVIDER_jpeg = "libjpeg-turbo"
PREFERRED_PROVIDER_jpeg-native = "libjpeg-turbo-native"

#--------------------------
# Preferred provider
# for openvt tools
PREFERRED_PROVIDER_console-tools = "kbd"

#--------------------------
# Preferred provider
# splash
SPLASH = "${@bb.utils.contains('COMBINED_FEATURES', 'splashscreen', 'psplash-drm', '', d)}"
PREFERRED_PROVIDER_virtual/psplash = "${@bb.utils.contains('COMBINED_FEATURES', 'splashscreen', 'psplash-drm', '', d)}"
```

## layers/pantry-io/conf/layer.conf
```bitbake
# We have a conf and classes directory, add to BBPATH
BBPATH .= ":${LAYERDIR}"

# We have recipes-* directories, add to BBFILES
BBFILES += "${LAYERDIR}/recipes-*/*/*.bb \
            ${LAYERDIR}/recipes-*/*/*.bbappend"

BBFILE_COLLECTIONS += "pantry-io"
BBFILE_PATTERN_pantry-io = "^${LAYERDIR}/"
BBFILE_PRIORITY_pantry-io = "7"

LAYERDEPENDS_pantry-io = "core"
LAYERSERIES_COMPAT_pantry-io = "kirkstone"
```
